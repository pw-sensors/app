## manifest/west.yml
```yaml
# Copyright (c) 2023 Google LLC
# SPDX-License-Identifier: Apache-2.0

manifest:
  remotes:
    - name: zephyr
      url-base: https://github.com/zephyrproject-rtos
    - name: pigweed
      url-base: git@github.com:pw-sensors/pigweed.git

  projects:
    - name: zephyr
      remote: zephyr
      revision: main
      import: true
    - name: pigweed
      remote: pigweed
      revision: main
```
